## drivers/block/zram/Kconfig
```kconfig
# SPDX-License-Identifier: GPL-2.0
config ZRAM
	tristate "Compressed RAM block device support"
	depends on BLOCK && SYSFS && MMU
	depends on CRYPTO_LZO || CRYPTO_ZSTD || CRYPTO_ZSTDP || CRYPTO_LZ4 || CRYPTO_LZ4HC || CRYPTO_LZ4K || CRYPTO_LZ4KD || CRYPTO_DEFLATE || CRYPTO_842
	select ZSMALLOC
	help
	  Creates virtual block devices called /dev/zramX (X = 0, 1, ...).
	  Pages written to these disks are compressed and stored in memory
	  itself. These disks allow very fast I/O and compression provides
	  good amounts of memory savings.

	  It has several use cases, for example: /tmp storage, use as swap
	  disks and maybe many more.

	  See Documentation/admin-guide/blockdev/zram.rst for more information.

choice
	prompt "Default zram compressor"
	default ZRAM_DEF_COMP_LZORLE
	depends on ZRAM

config ZRAM_DEF_COMP_LZORLE
	bool "lzo-rle"
	depends on CRYPTO_LZO

config ZRAM_DEF_COMP_ZSTD
	bool "zstd"
	depends on CRYPTO_ZSTD

config ZRAM_DEF_COMP_ZSTDP
	bool "zstdp"
	depends on CRYPTO_ZSTDP

config ZRAM_DEF_COMP_LZ4
	bool "lz4"
	depends on CRYPTO_LZ4

config ZRAM_DEF_COMP_LZO
	bool "lzo"
	depends on CRYPTO_LZO

config ZRAM_DEF_COMP_LZ4HC
	bool "lz4hc"
	depends on CRYPTO_LZ4HC

config ZRAM_DEF_COMP_842
	bool "842"
	depends on CRYPTO_842

endchoice

config ZRAM_DEF_COMP
	string
	default "lzo-rle" if ZRAM_DEF_COMP_LZORLE
	default "zstd" if ZRAM_DEF_COMP_ZSTD
	default "zstdp" if ZRAM_DEF_COMP_ZSTDP
	default "lz4" if ZRAM_DEF_COMP_LZ4
	default "lzo" if ZRAM_DEF_COMP_LZO
	default "lz4hc" if ZRAM_DEF_COMP_LZ4HC
	default "842" if ZRAM_DEF_COMP_842

config ZRAM_WRITEBACK
       bool "Write back incompressible or idle page to backing device"
       depends on ZRAM
       help
	 With incompressible page, there is no memory saving to keep it
	 in memory. Instead, write it out to backing device.
	 For this feature, admin should set up backing device via
	 /sys/block/zramX/backing_dev.

	 With /sys/block/zramX/{idle,writeback}, application could ask
	 idle page's writeback to the backing device to save in memory.

	 See Documentation/admin-guide/blockdev/zram.rst for more information.

config ZRAM_MEMORY_TRACKING
	bool "Track zRam block status"
	depends on ZRAM && DEBUG_FS
	help
	  With this feature, admin can track the state of allocated blocks
	  of zRAM. Admin could see the information via
	  /sys/kernel/debug/zram/zramX/block_state.

	  See Documentation/admin-guide/blockdev/zram.rst for more information.

config ZRAM_MULTI_COMP
	bool "Enable multiple compression streams"
	depends on ZRAM
	help
	  This will enable multi-compression streams, so that ZRAM can
	  re-compress pages using a potentially slower but more effective
	  compression algorithm. Note, that IDLE page recompression
	  requires ZRAM_MEMORY_TRACKING.

config ZRAM_OPT_STATS
	bool "ZRAM optimization: extended per-device statistics"
	depends on ZRAM
	help
	  Portable optimization item (refactored from the MIUI zram stats
	  feature). Tracks extra per-zram-device statistics such as
	  lifetime/access-time of stored pages and idle-writeback counts.
	  No vendor/cgroup infrastructure required. Exposed via
	  /sys/block/zramX/.

config ZRAM_UNLIMITED_WRITEBACK
	bool "ZRAM optimization: unlimited writeback quota mode"
	depends on ZRAM
	depends on ZRAM_WRITEBACK
	help
	  Portable optimization item (refactored from the MIUI MemoryFreeze
	  writeback feature). Allows selected pages to bypass the normal
	  writeback size limit via a sysfs quota tunable, improving memory
	  reclaim headroom under high memory pressure. This is a generic
	  zram-internal optimization and does NOT depend on any vendor
	  memory-freeze cgroup.

config ZRAM_ANON_WRITEBACK
	bool "ZRAM: vendor per-memcg anon writeback control (needs vendor mem_cgroup)"
	depends on ZRAM
	depends on ZRAM_WRITEBACK
	help
	  Vendor (oplus/mediatek) integration item: registers the legacy
	  memory-cgroup file "anno_writeback_control" and honours the
	  vendor-only field struct mem_cgroup::android_oem_data1 to tag
	  pages as writeback-protected / writeback-unlimited.

	  android_oem_data1 does NOT exist in a clean GKI/AOSP
	  struct mem_cgroup, therefore this option defaults to n. Enabling
	  it on a kernel whose struct mem_cgroup lacks android_oem_data1
	  will fail to compile. Keep it off unless you know your tree has
	  the vendor memcg patch.

config ZRAM_KCOMPRESSD_OPT
	bool "use Kcompressd thread to Boost ZRAM Performance"
	depends on ZRAM
	help
	  use a separate kernel thread ("Kcompressd") to assist with
	  zram_bio request, there improve ZRAM compress performance

config ZRAM_KSHRINK_SLABD
	bool "use kshrink_slabd thread Offload the load kswapd0"
	depends on ZRAM
	help
	  Used to convert synchronous, blocking garbage collection
	  to async garbage collection in a background kernel thread,
	  thereby reducing system latency on under high memory load.
```
